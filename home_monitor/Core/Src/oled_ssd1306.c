/**
 * @file    oled_ssd1306.c
 * @brief   OLED SSD1306 驱动实现（I2C）
 */

#include "oled_ssd1306.h"
#include "stm32f1xx_hal.h"
#include <string.h>
#include <stdio.h>

/* 可配置项 ----------------------------------------------------------------*/
#define OLED_I2C            hi2c1
#define OLED_ADDR           0x78    // 7位地址左移1位（0x3C << 1）

/* 私有变量 ----------------------------------------------------------------*/
static uint8_t buffer[OLED_WIDTH * OLED_HEIGHT / 8];  // 1024 bytes

/* 外部变量 ----------------------------------------------------------------*/
extern I2C_HandleTypeDef OLED_I2C;

/* 私有函数 ----------------------------------------------------------------*/

static void OLED_WriteCmd(uint8_t cmd)
{
    uint8_t data[] = {0x00, cmd};
    HAL_I2C_Master_Transmit(&OLED_I2C, OLED_ADDR, data, 2, 100);
}

static void OLED_WriteData(uint8_t dat)
{
    uint8_t data[] = {0x40, dat};
    HAL_I2C_Master_Transmit(&OLED_I2C, OLED_ADDR, data, 2, 100);
}

/* 6x8 ASCII 字库（空格 ~ 波浪号）*/
static const uint8_t Font6x8[][6] = {
    {0x00,0x00,0x00,0x00,0x00,0x00}, // SP
    {0x00,0x00,0x5F,0x00,0x00,0x00}, // !
    {0x00,0x07,0x00,0x07,0x00,0x00}, // "
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    {0x08,0x08,0x2A,0x1C,0x08,0x00}, // ~
};

/* 公有函数 ----------------------------------------------------------------*/

void OLED_Init(void)
{
    HAL_Delay(100);

    OLED_WriteCmd(0xAE); // display off
    OLED_WriteCmd(0x20); // memory addressing mode
    OLED_WriteCmd(0x00); // horizontal
    OLED_WriteCmd(0xB0); // page start
    OLED_WriteCmd(0xC8); // COM scan direction remapped
    OLED_WriteCmd(0x00); // low column
    OLED_WriteCmd(0x10); // high column
    OLED_WriteCmd(0x40); // start line
    OLED_WriteCmd(0x81); // contrast
    OLED_WriteCmd(0xFF);
    OLED_WriteCmd(0xA1); // segment remap
    OLED_WriteCmd(0xA6); // normal display
    OLED_WriteCmd(0xA8); // multiplex ratio
    OLED_WriteCmd(0x3F);
    OLED_WriteCmd(0xA4); // resume to RAM content
    OLED_WriteCmd(0xD3); // display offset
    OLED_WriteCmd(0x00);
    OLED_WriteCmd(0xD5); // display clock divide
    OLED_WriteCmd(0xF0);
    OLED_WriteCmd(0xD9); // pre-charge period
    OLED_WriteCmd(0x22);
    OLED_WriteCmd(0xDA); // COM pins
    OLED_WriteCmd(0x12);
    OLED_WriteCmd(0xDB); // VCOMH deselect
    OLED_WriteCmd(0x20);
    OLED_WriteCmd(0x8D); // charge pump
    OLED_WriteCmd(0x14);
    OLED_WriteCmd(0xAF); // display on

    OLED_Clear();
    OLED_Refresh();
}

void OLED_Clear(void)
{
    memset(buffer, 0, sizeof(buffer));
}

void OLED_Refresh(void)
{
    for (uint8_t page = 0; page < 8; page++)
    {
        OLED_WriteCmd(0xB0 + page);
        OLED_WriteCmd(0x00);
        OLED_WriteCmd(0x10);

        for (uint8_t col = 0; col < OLED_WIDTH; col++)
        {
            OLED_WriteData(buffer[page * OLED_WIDTH + col]);
        }
    }
}

void OLED_DrawPixel(uint8_t x, uint8_t y, uint8_t color)
{
    if (x >= OLED_WIDTH || y >= OLED_HEIGHT) return;

    if (color)
        buffer[x + (y / 8) * OLED_WIDTH] |=  (1 << (y % 8));
    else
        buffer[x + (y / 8) * OLED_WIDTH] &= ~(1 << (y % 8));
}


/* ================================================================
   扩展绘图函数
   ================================================================ */

void OLED_FillRect(uint8_t x, uint8_t y, uint8_t w, uint8_t h, uint8_t color)
{
    for (uint8_t i = x; i < x + w && i < OLED_WIDTH; i++)
        for (uint8_t j = y; j < y + h && j < OLED_HEIGHT; j++)
            OLED_DrawPixel(i, j, color);
}

void OLED_DrawHLine(uint8_t x, uint8_t y, uint8_t w, uint8_t color)
{
    OLED_FillRect(x, y, w, 1, color);
}

void OLED_DrawVLine(uint8_t x, uint8_t y, uint8_t h, uint8_t color)
{
    OLED_FillRect(x, y, 1, h, color);
}

void OLED_DrawRect(uint8_t x, uint8_t y, uint8_t w, uint8_t h, uint8_t color)
{
    OLED_DrawHLine(x, y, w, color);
    OLED_DrawHLine(x, y + h - 1, w, color);
    OLED_DrawVLine(x, y, h, color);
    OLED_DrawVLine(x + w - 1, y, h, color);
}

void OLED_DrawProgressBar(uint8_t x, uint8_t y, uint8_t w, uint8_t percent)
{
    uint8_t fill_w = (uint8_t)((uint16_t)w * percent / 100);
    OLED_DrawRect(x, y, w, 8, 1);
    if (fill_w > 1)
        OLED_FillRect(x + 1, y + 1, fill_w - 1, 6, 1);
}

void OLED_InvertArea(uint8_t x, uint8_t y, uint8_t w, uint8_t h)
{
    uint8_t y_end = (y + h > OLED_HEIGHT) ? OLED_HEIGHT : y + h;
    uint8_t x_end = (x + w > OLED_WIDTH)  ? OLED_WIDTH  : x + w;
    for (uint8_t j = y; j < y_end; j++)
        for (uint8_t i = x; i < x_end; i++)
        {
            uint8_t byte_idx = i + (j / 8) * OLED_WIDTH;
            buffer[byte_idx] ^= (1 << (j % 8));
        }
}
void OLED_ShowString(uint8_t x, uint8_t y, const char *str)
{
    while (*str)
    {
        uint8_t ch = *str - 0x20; // 字库从空格开始
        if (ch > 90) ch = 0;      // 超出范围显示空格

        for (uint8_t i = 0; i < 6; i++)
        {
            buffer[x + (y * 128) + i] = Font6x8[ch][i];
        }

        x += 6;
        if (x > 122) { x = 0; y++; }
        str++;
    }
}

void OLED_ShowNum(uint8_t x, uint8_t y, uint32_t num, uint8_t len)
{
    char buf[12];
    snprintf(buf, sizeof(buf), "%*lu", len, (unsigned long)num);
    OLED_ShowString(x, y, buf);
}

void OLED_ShowChinese(uint8_t x, uint8_t y, uint8_t index)
{
    // 预留：外部提供16x16汉字字库
    (void)x; (void)y; (void)index;
}


